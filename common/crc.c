#include "crc.h"
#include "hal.h"

#define CRC32_POLYNOMIAL            0x04C11DB7U
#define CRC16_CCITT_POLYNOMIAL      0x1021U
#if (STM32_CRC_PROGRAMMABLE == TRUE)
#define REVBIT(n)                 (n)
#else
#define REVBIT(n)                 __RBIT(n)
#endif

static const uint32_t crc32_table[256] = {
    0x00000000,  0x77073096,  0xee0e612c,  0x990951ba,
    0x076dc419,  0x706af48f,  0xe963a535,  0x9e6495a3,
    0x0edb8832,  0x79dcb8a4,  0xe0d5e91e,  0x97d2d988,
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    0xb40bbe37,  0xc30c8ea1,  0x5a05df1b,  0x2d02ef8d };

static const uint16_t crc16_ccitt_table[256] = {
    0x0000U, 0x1021U, 0x2042U, 0x3063U, 0x4084U, 0x50A5U, 0x60C6U, 0x70E7U,
    0x8108U, 0x9129U, 0xA14AU, 0xB16BU, 0xC18CU, 0xD1ADU, 0xE1CEU, 0xF1EFU,
    0x1231U, 0x0210U, 0x3273U, 0x2252U, 0x52B5U, 0x4294U, 0x72F7U, 0x62D6U,
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    0x6E17U, 0x7E36U, 0x4E55U, 0x5E74U, 0x2E93U, 0x3EB2U, 0x0ED1U, 0x1EF0U };

uint32_t crc32_hw(const uint8_t block[], size_t len, uint32_t crc)
{
#if (STM32_CRC_PROGRAMMABLE == TRUE)
    /* Configure CRC32 polynomial */
    CRC->POL = CRC32_POLYNOMIAL;
    CRC->CR = _VAL2FLD(CRC_CR_POLYSIZE, 0) | _VAL2FLD(CRC_CR_REV_IN, 3) | CRC_CR_REV_OUT;
#endif
    if (crc == 0xFFFFFFFFU) {
        CRC->CR |= CRC_CR_RESET;
    }
    size_t i = 0;
    while (len && (len % 4) == 0) {
        CRC->DR = REVBIT(*((uint32_t*)&block[i]));
        crc = REVBIT(CRC->DR);
        len -= 4;
        i += 4;
    }
    crc = crc32_sw(&block[i], len, crc);
    return crc;
}

uint32_t crc32_sw(const uint8_t block[], size_t len, uint32_t crc)
{
  for (size_t i = 0; i < len; i++) {
    crc = (crc >> 8) ^ crc32_table[(crc & 0xff) ^ block[i]];
  }
  return crc;
}

uint32_t crc32(const uint8_t block[], size_t len, uint32_t crc)
{
    crc = ~crc;
#if (USE_CRC_HW == TRUE && STM32_HAS_CRC == TRUE)
    crc = crc32_hw(block, len, crc);
#else /* USE_CRC_HW == FALSE || STM32_HAS_CRC == FALSE */
    crc = crc32_sw(block, len, crc);
#endif
    return ~crc;
}

#if (STM32_CRC_PROGRAMMABLE == TRUE)
uint16_t crc16_ccitt_hw(const uint8_t block[], size_t len, uint16_t crc)
{
    /* Configure CRC-16-CCITT polynomial */
    CRC->POL = CRC16_CCITT_POLYNOMIAL;
    CRC->CR = _VAL2FLD(CRC_CR_POLYSIZE, 1);
    if (crc == 0xFFFFU) {
        CRC->CR |= CRC_CR_RESET;
    }
    size_t i = 0;
    while (len && (len % 2) == 0) {
        CRC->DR = *((uint16_t*)&block[i]);
        crc = CRC->DR;
        len -= 2;
        i += 2;
    }
    crc = crc16_sw(&block[i], len, crc);
    return crc;
}
#endif

uint16_t crc16_ccitt_sw(const uint8_t block[], size_t len, uint16_t crc)
{
    for (size_t i = 0; i < len; i++) {
        uint8_t tmp = (uint8_t)(crc >> 8U) ^ block[i];
        crc = (crc << 8U) ^ crc16_ccitt_table[tmp];
    }
    return crc;
}

uint16_t crc16_ccitt_new(const uint8_t block[], size_t len, uint16_t crc)
{
#if (USE_CRC_HW == TRUE && STM32_HAS_CRC == TRUE && STM32_CRC_PROGRAMMABLE == TRUE)
    crc = crc16_ccitt_hw(block, len, crc);
#else /* USE_CRC_HW == FALSE || STM32_HAS_CRC == FALSE || STM32_CRC_PROGRAMMABLE == FALSE */
    crc = crc16_ccitt_sw(block, len, crc);
#endif
    return crc;
}
