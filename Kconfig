## west.yml
```yaml
manifest:
  remotes:
    - name: zephyrproject-rtos
      url-base: https://github.com/zephyrproject-rtos
    - name: oresat
      url-base: https://github.com/oresat
    - name: canopennode
      url-base: https://github.com/CANopenNode
  defaults:
    remote: oresat
  group-filter: [+optional]
  projects:
    - name: zephyr
      remote: zephyrproject-rtos
      revision: v4.4.1
      import:
        # below, only import Zephyr modules we need;
        # extend this per app in submanifests: see oresat-template-app
        name-allowlist:
          - cmsis_6
          - hal_stm32
          - hal_nxp
          - canopennode
          - mcuboot
    - name: oresat-mag-app
      revision: feature-beecon-prism-release
      path: apps/mag
      #import: submanifests
    - name: oresat-reaction-wheel-app
      revision: main
      path: apps/reaction-wheel
      #import: submanifests
    - name: oresat-battery-app
      revision: feature-beecon-prism-release
      path: apps/battery
      #import: submanifests
    - name: oresat-solar-app
      revision: feature-osiris-release
      path: apps/solar
      #import: submanifests
    - name: oresat-template-app
      revision: main
      path: apps/template
      import: submanifests

  self:
    path: common
    #import: submanifests
```
