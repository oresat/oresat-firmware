## west.yml
```yaml
manifest:
  remotes:
    - name: zephyrproject-rtos
      url-base: https://github.com/zephyrproject-rtos
    - name: oresat
      url-base: https://github.com/oresat
  defaults:
    remote: oresat
  group-filter: [+optional]
  projects:
    - name: zephyr
      remote: zephyrproject-rtos
      revision: v4.5.0
      import:
        # below, only import Zephyr modules we need;
        # extend this per app in submanifests: see oresat-template-app
        name-allowlist:
          - cmsis_6
          - hal_stm32
          - hal_nxp
          - mcuboot
          - segger
    - name: oresat-mag-app
      revision: feature-zephyr-4.5.0
      path: apps/mag
      #import: submanifests
    - name: oresat-reaction-wheel-app
      revision: main
      path: apps/reaction-wheel
      #import: submanifests
    - name: oresat-battery-app
      revision: feature-zephyr-4.5.0
      path: apps/battery
      #import: submanifests
    - name: oresat-solar-app
      revision: feature-zephyr-4.5.0
      path: apps/solar
      #import: submanifests
    - name: oresat-template-app
      revision: feature-zephyr-4.5.0
      path: apps/template
      #import: submanifests
    - name: CANopenNodeZephyr
      remote: zephyrproject-rtos
      revision: main
      submodules:
        - path: CANopenNode
      path: custom/lib/canopennode

  self:
    path: common
    #import: submanifests
```
